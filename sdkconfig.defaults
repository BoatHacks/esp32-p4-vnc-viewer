## sdkconfig.defaults
```kconfig
# This board actually has 32MB of flash, but CONFIG_ESPTOOLPY_FLASHSIZE_32MB
# turned out not to be a valid choice for this target/IDF version - it was
# silently ignored rather than erroring, leaving the default at 2MB. 8MB is
# a flash size choice that's reliably supported everywhere, and comfortably
# fits partitions.csv's layout (~6MB used) with room to spare; it just means
# the remaining ~24MB on this particular board goes unused.
CONFIG_ESPTOOLPY_FLASHSIZE_8MB=y

# OTA needs two app slots (ota_0/ota_1) plus an otadata partition - the
# default single-app partition table doesn't have room for that.
CONFIG_PARTITION_TABLE_CUSTOM=y
CONFIG_PARTITION_TABLE_CUSTOM_FILENAME="partitions.csv"

# If a freshly-flashed OTA image never confirms itself as good (see
# ota_update.c's ota_mark_running_app_valid()), the bootloader
# automatically rolls back to the previous working image on the next
# boot - much better than a bad update silently bricking a device with
# no physical keyboard to debug it from.
CONFIG_BOOTLOADER_APP_ROLLBACK_ENABLE=y

# DES is disabled by default in mbedtls (default n - it's a legacy,
# insecure cipher) but rfb_client.c genuinely needs it: classic VNC
# authentication (RFB security type 2) is specified as DES challenge-
# response, and that's inherent to the VNC protocol, not something we
# can avoid while still supporting VNC Auth.
CONFIG_MBEDTLS_DES_C=y

# Target
CONFIG_IDF_TARGET="esp32p4"

# The RFB framebuffer (1024*600*2 bytes ~= 1.2MB) and the LVGL-free
# double-copy path both want PSRAM, not internal SRAM.
CONFIG_SPIRAM=y
# Real hardware showed PSRAM running at only 20MHz despite
# CONFIG_SPIRAM_SPEED_200M below, causing continuous MIPI-DSI DPI
# underrun errors ("can't fetch data from external memory fast enough") -
# the display simply couldn't be fed fast enough. Root cause, verified
# against the real esp-idf Kconfig (components/esp_psram/esp32p4/
# Kconfig.spiram) and Espressif's own MIPI-DSI example sdkconfig:
#  - CONFIG_SPIRAM_SPEED_200M silently depends on
#    CONFIG_IDF_EXPERIMENTAL_FEATURES, which we never enabled, so it was
#    ignored and fell back to the Kconfig's own default (20MHz).
#  - CONFIG_SPIRAM_MODE_OCT doesn't exist as an option for the P4 at all
#    (only SPIRAM_MODE_HEX, matching the "hex_psram" driver tag this
#    board's own boot log prints) - harmless no-op, but wrong/confusing.
CONFIG_IDF_EXPERIMENTAL_FEATURES=y
CONFIG_SPIRAM_MODE_HEX=y
CONFIG_SPIRAM_SPEED_200M=y
CONFIG_SPIRAM_USE_MALLOC=y
CONFIG_SPIRAM_MALLOC_ALWAYSINTERNAL=16384
# Real hardware boot crash: `assert failed: sdio_mempool_create sdio_drv.c:255`
# / "HS_MP: mempool create failed: no mem". esp_hosted's SDIO transport
# buffer pool defaults to internal DMA-capable RAM, and this project's
# Wi-Fi/VNC setup UI (LVGL) uses enough of that RAM that the pool can't
# fit. This tells esp_hosted to try DMA-capable PSRAM first instead -
# available on the P4 - falling back to internal RAM only if that fails.
CONFIG_ESP_HOSTED_MEMPOOL_PREFER_SPIRAM=y

# esp_wifi_remote's WIFI_RMT_CACHE_TX_BUFFER_NUM Kconfig option (used by
# WIFI_INIT_CONFIG_DEFAULT()) only gets a value when this is enabled -
# without it, that macro fails to expand and main won't compile.
CONFIG_SPIRAM_TRY_ALLOCATE_WIFI_LWIP=y

# Networking headroom - the VNC socket + Wi-Fi remote transport both need
# a bit more than the defaults.
CONFIG_LWIP_MAX_SOCKETS=10
CONFIG_LWIP_SO_RCVBUF=y

# Main task stack: BSP init + Wi-Fi + first TCP connect all happen here
# before we hand off to dedicated tasks.
CONFIG_ESP_MAIN_TASK_STACK_SIZE=8192

# esp_wifi_remote / esp_hosted talk to the onboard ESP32-C6 over SDIO.
# The exact Kconfig symbols are added by those components once you've
# run `idf.py add-dependency`; set the slave target to esp32-c6 via
# `idf.py menuconfig` -> Component config -> Wi-Fi Remote.

# The Wi-Fi setup UI's titles use Montserrat 24 - LVGL only ships 14 by
# default.
CONFIG_LV_FONT_MONTSERRAT_24=y
```
